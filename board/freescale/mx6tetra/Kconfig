## board/freescale/mx6tetra/Kconfig
```kconfig
if TARGET_MX6TETRA

config SYS_BOARD
	default "mx6tetra"

config SYS_VENDOR
	default "freescale"

config SYS_CONFIG_NAME
	default "mx6tetra"

endif
```

## board/versalogic/mx6zebra/Kconfig
```kconfig
if TARGET_MX6ZEBRA

config SYS_BOARD
	default "mx6zebra"

config SYS_VENDOR
	default "freescale"

config SYS_CONFIG_NAME
	default "mx6zebra"

endif
```

## configs/mx6qtetra_defconfig
```kconfig
CONFIG_ARM=y
CONFIG_ARCH_MX6=y
CONFIG_TARGET_MX6TETRA=y
CONFIG_SYS_EXTRA_OPTIONS="IMX_CONFIG=board/freescale/mx6tetra/mx6q_4x_mt41j256_tetra.cfg,MX6Q,SYS_BOOT_SPINOR"
CONFIG_CMD_GPIO=y
CONFIG_SPI_FLASH=y
CONFIG_SPI_FLASH_WINBOND=y
CONFIG_SPI_FLASH_MTD=y
```

## configs/mx6qtetraandroid_defconfig
```kconfig
CONFIG_SYS_EXTRA_OPTIONS="IMX_CONFIG=board/freescale/mx6tetra/mx6q_4x_mt41j256_tetra.cfg,MX6Q,ANDROID_SUPPORT"
CONFIG_ARM=y
CONFIG_TARGET_MX6TETRA=y
CONFIG_SYS_MALLOC_F=y
CONFIG_SYS_MALLOC_F_LEN=0x400
CONFIG_DM=y
CONFIG_DM_THERMAL=y
CONFIG_SPI_FLASH=y
CONFIG_SPI_FLASH_WINBOND=y
CONFIG_SPI_FLASH_USE_4K_SECTORS=y
CONFIG_SPI_FLASH_MTD=y
```

## configs/mx6solozebra_defconfig
```kconfig
CONFIG_ARM=y
CONFIG_ARCH_MX6=y
CONFIG_TARGET_MX6ZEBRA=y
CONFIG_SYS_EXTRA_OPTIONS="IMX_CONFIG=board/versalogic/mx6zebra/mx6solo_2x_mt41j128_zebra.cfg,MX6DL,SYS_BOOT_SPINOR"
CONFIG_CMD_GPIO=y
CONFIG_SPI_FLASH=y
CONFIG_SPI_FLASH_WINBOND=y
CONFIG_SPI_FLASH_MTD=y
```
